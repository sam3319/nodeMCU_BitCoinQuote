// 라이브러리 설정
#include <Wire.h> // I2C통신을 위한 라이브러리 (OLED 장치와 통신)
#include <Adafruit_GFX.h> // Adafruit_GFX 그래픽 라이브러리
#include <Adafruit_SSD1306.h> // Adafruit의 OLED 디스플레이 드라이버 라이브러리
#include <ESP8266WiFi.h> // ESP8266 모듈의 WiFi 제어 라이브러리
#include <ESP8266HTTPClient.h> // HTTP 클라이언트와 웹 서버 연결 라이브러리
#include <WiFiClientSecure.h> // HTTPS 요청 지원 라이브러리
#include <ArduinoJson.h> // JSON 데이터 제어 라이브러리
#include <UniversalTelegramBot.h> //
// OLED, LED 설정
#define SCREEN_WIDTH 128  // OLED 너비 설정
#define SCREEN_HEIGHT 64  // OLED 높이 설정
#define OLED_RESET -1 // OLED RESET PIN
#define GREEN D5
#define RED D6
// 텔레그램 봇 설정
#define BOT_TOKEN "7801828511:AAH6YUWapVNazea9h435sSKTjXCf8N75nf4"  // 봇 TOKEN 설정
#define CHAT_ID "8179034757"  // 챗 ID 설정
// 객체 생성
Adafruit_SSD1306 display(SCREEN_WIDTH, SCREEN_HEIGHT, &Wire, OLED_RESET); // OLED 객체 생성
WiFiClientSecure client; // HTTPS 보안연결 객체 생성
UniversalTelegramBot bot(BOT_TOKEN, client); // 텔래그램 봇 생성
X509List cert(TELEGRAM_CERTIFICATE_ROOT);

float averagePurchasePrice; // 평균 매입가
float profitPercentage; // 이익률

// WiFi 설정 변수
const char* ssid = "iptime602";
const char* password = "iptime602";

// JSON API URL
const char* url = "https://api.bithumb.com/v1/ticker?markets=KRW-BTC";

// 비트코인 로고 (128x64)
const unsigned char bitcoinLogo[] PROGMEM = {
  0x00, 0x00, 0x00, 0x00, 0x00, 0x00, 0x00, 0x00, 0x00, 0x00, 0x00, 0x00, 0x00, 0x00, 0x00, 0x00,   
  0x00, 0x00, 0x00, 0x00, 0x00, 0x00, 0x00, 0x00, 0x00, 0x00, 0x00, 0x00, 0x00, 0x00, 0x00, 0x00,   
  0x00, 0x00, 0x00, 0x00, 0x00, 0x00, 0x00, 0x00, 0x00, 0x00, 0x00, 0x00, 0x00, 0x00, 0x00, 0x00,   
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  0x00, 0x00, 0x00, 0x00, 0x00, 0x00, 0x00, 0x00, 0x00, 0x00, 0x00, 0x00, 0x00, 0x00, 0x00, 0x00 
};

void setup() {
  // LED 변수 초기화
  pinMode(GREEN, OUTPUT); 
  pinMode(RED, OUTPUT);  

  // 사라얼 모니터 초기화
  Serial.begin(115200);

  // OLED 초기화
  display.begin(SSD1306_SWITCHCAPVCC, 0x3C);
 
  // WiFi 연결
  WiFi.begin(ssid, password);

  // OLED 초기설정
  display.setTextColor(SSD1306_WHITE);
  display.clearDisplay();
  display.setTextSize(1);
  printCenter("Connecting to WiFi..", 0, 25);  
  // 
  client.setTrustAnchors(&cert);
  client.setInsecure();
  while (WiFi.status() != WL_CONNECTED) {
    delay(1000);
    Serial.println("Connecting to WiFi..");
  }
  display.clearDisplay();
  printCenter("WiFi Connected", 0, 25);  
  display.display();
  delay(2000);

  // 텔레그램에 평단가 입력 요청 메시지 전송
  bot.sendMessage(CHAT_ID, "평단가를 입력해주세요.", "");
}

void loop() {
  // 평단가 입력 처리
  if (Serial.available() > 0) {
    String input = Serial.readStringUntil('\n'); // 사용자 입력 받기
    averagePurchasePrice = input.toFloat(); // 입력값을 float로 변환
    Serial.print("입력된 평단가: ");
    Serial.println(input); // 입력된 평단가 출력

    // 텔레그램에 입력된 평단가 알리기
    bot.sendMessage(CHAT_ID, "입력된 평단가: " + String(averagePurchasePrice), "");
  }
  // 평단가가 0일 경우 입력 요청
  if (averagePurchasePrice <= 0) {
    Serial.println("평단가를 입력해주세요.");
  }
  display.clearDisplay(); // 화면의 모든 내용을 지우기
  display.drawBitmap(0, 0, bitcoinLogo, 128, 64, WHITE); // 배열로 정의된 비트맵 이미지를 출력
  display.display(); // 메모리에 그린 내용 화면에 출력
  delay(3000);

  if (WiFi.status() == WL_CONNECTED) {
    client.setInsecure(); // SSL 인증서 검증 비활성화
    HTTPClient http;

    // API 요청
    http.begin(client, url); // HTTPS 요청
    int httpCode = http.GET();

    if (httpCode > 0) {
      String payload = http.getString();

      // JSON 파싱
      DynamicJsonDocument doc(1024);
      deserializeJson(doc, payload);
      
      // 데이터 가져오기
      float price = doc[0]["trade_price"]; // 종가(현재가)값 가져오기
      String change_rate = doc[0]["signed_change_rate"] + " % "; // 24시간 기준 변화율 값 가져오기

      //수익률 계산
      if (averagePurchasePrice > 0) { // 평단가가 0보다 클 때만 수익률 계산
        profitPercentage = ((price - averagePurchasePrice) / averagePurchasePrice) * 100;
      } else {
        profitPercentage = 0; // 평단가가 0일 경우 수익률을 0으로 설정
      }
      Serial.print("수익률: ");
      Serial.println(profitPercentage); // 수익률 출력

      // 가격을 포맷팅 출력
      String forMatPrice = formatWithCommas(price);

      // 가격 표시
      display.clearDisplay();
      display.setTextSize(1);
      printCenter("BTC/KRW", 0, 5);
      display.setTextSize(1);  
      printCenter(forMatPrice, 0, 30);  

      // 변화율 표시
      display.setTextSize(1);
      printCenter(change_rate, 0, 55); 

      display.display();

      delay(3000);

      // 평단가 포맷팅
      if (averagePurchasePrice > 0) { // 평균 매입가가 0보다 클 때만 포맷팅
      String forMatAvrPrice = formatWithCommas(averagePurchasePrice);

      // 사용자 지갑 표시
      display.clearDisplay();
      display.setTextSize(1);
      printCenter("My Portfolio", 0, 5);
      display.setTextSize(1);  
      printCenter(forMatAvrPrice, 0, 30);
      }

      // 수익률 표시
      if (averagePurchasePrice > 0) {
        display.setTextSize(1);
        printCenter(String(profitPercentage) + " %", 0, 55);
      }
      display.display(); // 변경된 내용을 디스플레이에 출력
      // 수익이 있으면 초록색 LED ON
      if(profitPercentage > 0){
        digitalWrite(GREEN, HIGH);  
        digitalWrite(RED, LOW);  
      }
      // 수익이 없으면 빨간색 LED ON
      else{
        digitalWrite(GREEN, LOW);  
        digitalWrite(RED, HIGH);  
      }

    } else {
      Serial.println("HTTP request Error: " + String(httpCode));
    }
    http.end();
  } else {
    Serial.println("WiFi not connected");
  }
  delay(3000); // 10초마다 업데이트
}

// 가격 자릿수 지정 함수
String formatWithCommas(long number) {
  String result = "";
  String numStr = String(number);
  int len = numStr.length();

  for (int i = 0; i < len; i++) {
    if (i > 0 && (len - i) % 3 == 0) { result += ","; }
    result += numStr[i];
  }
  return result;
}

// OLED 출력 함수
void printCenter(const String buf, int x, int y)   {  
  int16_t x1, y1;  
  uint16_t w, h;  
  display.getTextBounds(buf, x, y, &x1, &y1, &w, &h);
  display.setCursor((x - w / 2) + (128 / 2), y);
  display.print(buf);
}  